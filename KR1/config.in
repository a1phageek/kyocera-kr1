## KR1/config.in
```kconfig
mainmenu_name 'uClinux Configuration'
mainmenu_option next_comment
comment 'Target Platform Selection'
comment 'Choose a Vendor/Product combination.'
choice 'Vendor/Product' "Realtek/MTD CONFIG_DEFAULTS_REALTEK_MTD \
Realtek/RTL8186 CONFIG_DEFAULTS_REALTEK_RTL8186 \
Realtek/rtl8650 CONFIG_DEFAULTS_REALTEK_RTL8650 \
Realtek/RTL865XB CONFIG_DEFAULTS_REALTEK_RTL865XB \
" SecureEdge/SecureEdgeVPN
comment 'Kernel is linux-2.4.x'
define_bool CONFIG_DEFAULTS_KERNEL_2_4 y
choice 'Libc Version' "uC-libc CONFIG_DEFAULTS_LIBC_UC_LIBC \
uClibc CONFIG_DEFAULTS_LIBC_UCLIBC \
" uClibc
bool 'Default all settings (lose changes)'	CONFIG_DEFAULTS_OVERRIDE
bool 'Customize Kernel Settings'			CONFIG_DEFAULTS_KERNEL
bool 'Customize Vendor/User Settings'		CONFIG_DEFAULTS_VENDOR
bool 'Update Default Vendor Settings'		CONFIG_DEFAULTS_VENDOR_UPDATE
endmenu
```

## KR1/linux-2.4.x/drivers/net/wireless/atheros/madwifi/patches/2.6/Kconfig.net-2.6.patch
```kconfig
--- /usr/src/linux-2.6.0/net/Kconfig	2004-01-22 08:11:55.869677752 -0800
+++ Kconfig.net	2004-01-22 08:09:48.811993456 -0800
@@ -420,6 +420,19 @@
 
 source "drivers/net/appletalk/Kconfig"
 
+config WLAN
+	tristate "IEEE 802.11 protocol support"
+	depends on EXPERIMENTAL && INET
+	---help---
+	  802.11 is the protocol used for wireless local area network
+	  communication.  This software implements the framework used by
+	  a variety of wireless network drivers.  If your Linux box is
+	  connected to a wireless network and you wish to connect to it,
+	  say Y.  
+
+	  To compile this driver as a module, choose M here: the module will be
+	  called wlan.  If unsure, say N.
+
 config X25
 	tristate "CCITT X.25 Packet Layer (EXPERIMENTAL)"
 	depends on EXPERIMENTAL
```

## KR1/linux-2.4.x/drivers/net/wireless/atheros/madwifi/patches/2.6/Kconfig.wireless-2.6.patch
```kconfig
--- /usr/src/linux-2.6.0/drivers/net/wireless/Kconfig	2004-01-22 08:12:19.038155608 -0800
+++ Kconfig.drivers	2004-01-22 08:10:36.648721168 -0800
@@ -292,6 +292,28 @@
 	 It has basic support for Linux wireless extensions and initial
 	 micro support for ethtool.
 
+config ATHEROS
+	tristate "Atheros cards"
+	depends on NET_RADIO && WLAN && EXPERIMENTAL
+	enable ATHEROS_HAL
+       ---help---
+	  Say Y here if you intend to attach an Atheros Cardbus or PCI
+	  wireless Ethernet networking card to your computer.  This
+	  driver support the standard Linux Wireless Extensions.
+
+	  You will also very likely also need the Wireless Tools in order to
+	  configure your card and that /etc/pcmcia/wireless.opts works:
+	  <http://www.hpl.hp.com/personal/Jean_Tourrilhes/Linux/Tools.html>.
+
+	  To compile this driver as a module, choose M here: the module will be
+	  called ath_pci.  If unsure, say N.
+
+# yes, this works even when no drivers are selected
+config ATHEROS_HAL
+	bool
+	depends on NET_RADIO && ATHEROS
+	default n
+
 # yes, this works even when no drivers are selected
 config NET_WIRELESS
 	bool
```

## KR1/linux-2.4.x/net/ipsec.20050322/Kconfig
```kconfig
#
# IPSEC configuration
# Copyright (C) 2004 Michael Richardson <mcr@freeswan.org>
# 
# This program is free software; you can redistribute it and/or modify it
# under the terms of the GNU General Public License as published by the
# Free Software Foundation; either version 2 of the License, or (at your
# option) any later version.  See <http://www.fsf.org/copyleft/gpl.txt>.
# 
# This program is distributed in the hope that it will be useful, but
# WITHOUT ANY WARRANTY; without even the implied warranty of MERCHANTABILITY
# or FITNESS FOR A PARTICULAR PURPOSE.  See the GNU General Public License
# for more details.
#
# RCSID $Id: Kconfig,v 1.1 2004/08/02 02:09:58 rupert Exp $

config KLIPS
	tristate "FreeS/WAN IPsec (KLIPS)"
	default n
	help
  	  KLIPS is the FreeS/WAN (www.freeswan.org) Kernel Level IP Security
	  system. It is extensively tested, and has interoperated with
	  many other systems. 
          It provides "ipsecX" devices on which one can do firewalling.
 	  It is maintained outside of the United States, so no export
	  controls apply (nor any fear of retroactive controls being imposed
	  by USA's BXA).  
          The userland, is compatible with both KLIPS and 26sec.

menu "KLIPS options"
	depends on KLIPS

config KLIPS_AUTH_HMAC_MD5
	bool 'HMAC-MD5 authentication algorithm' 
	default y
	help
           The HMAC-MD5 algorithm is used by ESP (and AH) to guarantee packet
	   integrity. There is little reason not to include it.

config KLIPS_AUTH_HMAC_SHA1
	bool 'HMAC-SHA1 authentication algorithm' 
	default y
	help
           The HMAC-SHA1 algorithm is used by ESP (and AH) to guarantee packet
	   integrity. SHA1 is a little slower than MD5, but is said to be 
	   a bit more secure. There is little reason not to include it.

config KLIPS_ENC_3DES
	bool '3DES encryption algorithm'
	default y
	help
           The 3DES algorithm is used by ESP to provide for packet privacy.
	   3DES is 3-repeats of the DES algorithm. 3DES is widely supported,
	   and analyzed and is considered very secure. 1DES is not supported.

config KLIPS_IPCOMP
	bool 'IP compression'
	default y
	help
           The IPcomp protocol is used prior to ESP to make the packet
	   smaller. Once encrypted, compression will fail, so any link
	   layer efforts (e.g. PPP) will not work. 

config KLIPS_DEBUG
	bool 'IPsec debugging'
	default y 
	help
           KLIPS includes a lot of debugging code. Unless there is a real
	   tangible benefit to removing this code, it should be left in place.
	   Debugging connections without access to kernel level debugging is
	   essentially impossible. Leave this on.

endmenu

#
#
# $Log: Kconfig,v $
# Revision 1.1  2004/08/02 02:09:58  rupert
# +: Add Freeswan IPSec 2.06
#
# Revision 1.3  2004/02/24 17:17:04  mcr
# 	s/CONFIG_IPSEC/CONFIG_KLIPS/ as 26sec uses "CONFIG_IPSEC" to
# 	turn it on/off as well.
#
# Revision 1.2  2004/02/22 06:50:42  mcr
# 	kernel 2.6 port - merged with 2.4 code.
#
# Revision 1.1.2.1  2004/02/20 02:07:53  mcr
# 	module configuration for KLIPS 2.6
#
#
```
